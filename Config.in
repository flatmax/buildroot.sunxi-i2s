## configs/audioinjector_custom_defconfig
```kconfig
#############################################
# audioinjector_custom_defconfig from here on
#
BR2_TARGET_GENERIC_HOSTNAME="audioinjector"
BR2_TARGET_GENERIC_ISSUE="Welcome to Audio Injector OS"

# neo specific from here on ...
BR2_TARGET_ROOTFS_EXT2_SIZE="250M"
BR2_DL_DIR="$(BASE_DIR)/../../buildroot.dl"

BR2_TOOLCHAIN_BUILDROOT_WCHAR=y

BR2_GLOBAL_PATCH_DIR="$(BR2_EXTERNAL)/patches"

# package options
#BR2_PACKAGE_FFTW_USE_NEON=y
#BR2_PACKAGE_EIGEN_UNSUPPORTED_MODULES=y

BR2_PACKAGE_BUSYBOX_CONFIG_FRAGMENT_FILES="$(BR2_EXTERNAL)/configs/busybox.fragment"

# setup options
BR2_ROOTFS_OVERLAY="$(BR2_EXTERNAL)/overlays"
#BR2_ROOTFS_USERS_TABLES="$(BR2_EXTERNAL)/users.txt"

#
BR2_TARGET_GENERIC_HOSTNAME="audioinjector"
BR2_TARGET_GENERIC_ISSUE="Welcome to Audio Injector OS"

# neo specific from here on ...
#BR2_TARGET_ROOTFS_EXT2_SIZE="250M"

# audio drivers
BR2_PACKAGE_AUDIOINJECTOR_ALSA=y

#BR2_TOOLCHAIN_BUILDROOT_WCHAR=y

BR2_GLOBAL_PATCH_DIR="$(BR2_EXTERNAL)/patches"

# package options
#BR2_PACKAGE_FFTW_USE_NEON=y
#BR2_PACKAGE_EIGEN_UNSUPPORTED_MODULES=y

# buildroot packages

# wifi
#BR2_PACKAGE_WPA_SUPPLICANT=y
#BR2_PACKAGE_RPI_WIFI_FIRMWARE=y
#BR2_PACKAGE_RPI_FIRMWARE_INSTALL_DTB_OVERLAYS=y

BR2_PACKAGE_BUSYBOX_CONFIG_FRAGMENT_FILES="$(BR2_EXTERNAL)/configs/busybox.fragment"

# setup options
BR2_ROOTFS_OVERLAY="$(BR2_EXTERNAL)/overlays"
#BR2_ROOTFS_USERS_TABLES="$(BR2_EXTERNAL)/users.txt"

# device tree setup
BR2_LINUX_KERNEL_DTS_SUPPORT=y
BR2_LINUX_KERNEL_USE_CUSTOM_DTS=y
#BR2_LINUX_KERNEL_CUSTOM_DTS_PATH="$(BR2_EXTERNAL)/package/audioinjector-alsa/audioinjector-nanopi/audioinjector-nanopi-neo-stereo.dts"
BR2_LINUX_KERNEL_CUSTOM_DTS_PATH="$(BR2_EXTERNAL)/package/audioinjector-alsa/audioinjector-nanopi/sun8i-h3-nanopi-neo.dts"
BR2_LINUX_KERNEL_CONFIG_FRAGMENT_FILES="$(BR2_EXTERNAL)/package/audioinjector-alsa/audioinjector-nanopi/kernel.fragment"

#BR2_TARGET_UBOOT_CONFIG_FRAGMENT_FILES="$(BR2_EXTERNAL)/package/audioinjector-alsa/audioinjector-nanopi/uboot.fragment"

# networking packages

# wifi
#BR2_PACKAGE_WPA_SUPPLICANT=y
#BR2_PACKAGE_RPI_WIFI_FIRMWARE=y
#BR2_PACKAGE_RPI_FIRMWARE_INSTALL_DTB_OVERLAYS=y

BR2_PACKAGE_OPENSSH=y
BR2_PACKAGE_OPENSSH_SERVER=y
BR2_PACKAGE_OPENSSH_CLIENT=y
BR2_SYSTEM_DHCP="eth0"

#BR2_PACKAGE_NTP=y
#BR2_PACKAGE_NTP_NTPDATE=y

BR2_PACKAGE_AVAHI=y
BR2_PACKAGE_AVAHI_DAEMON=y

# audio stuff
BR2_PACKAGE_ALSA_LIB=y
BR2_PACKAGE_LIBSAMPLERATE=y
BR2_PACKAGE_ALSA_UTILS=y
BR2_PACKAGE_ALSA_UTILS_AMIXER=y
BR2_PACKAGE_ALSA_UTILS_APLAY=y
BR2_PACKAGE_ALSA_UTILS_ALSAMIXER=y
```

## configs/nanopi_neo_defconfig
```kconfig
###### DON'T EDIT THIS FILE, EDIT audioinjector_custom_defconfig INSTEAD
BR2_arm=y
BR2_cortex_a7=y
BR2_ARM_FPU_VFPV4=y

BR2_TARGET_GENERIC_HOSTNAME="nanopi-neo"
BR2_TARGET_GENERIC_ISSUE="Welcome to Buildroot for the NanoPi NEO"

# Linux headers same as kernel, a 5.3 series
BR2_PACKAGE_HOST_LINUX_HEADERS_CUSTOM_5_3=y

# Use a -rc kernel to get the DTS
BR2_LINUX_KERNEL=y
BR2_LINUX_KERNEL_CUSTOM_VERSION=y
BR2_LINUX_KERNEL_CUSTOM_VERSION_VALUE="5.3.13"
BR2_LINUX_KERNEL_DEFCONFIG="sunxi"
BR2_LINUX_KERNEL_DTS_SUPPORT=y
BR2_LINUX_KERNEL_INTREE_DTS_NAME="sun8i-h3-nanopi-neo"

# Use an -rc tag because the defconfig is very recent
BR2_TARGET_UBOOT=y
BR2_TARGET_UBOOT_BUILD_SYSTEM_KCONFIG=y
BR2_TARGET_UBOOT_CUSTOM_VERSION=y
BR2_TARGET_UBOOT_CUSTOM_VERSION_VALUE="2019.10"
BR2_TARGET_UBOOT_BOARD_DEFCONFIG="nanopi_neo"
BR2_TARGET_UBOOT_NEEDS_DTC=y
BR2_TARGET_UBOOT_NEEDS_PYLIBFDT=y
BR2_TARGET_UBOOT_FORMAT_CUSTOM=y
BR2_TARGET_UBOOT_FORMAT_CUSTOM_NAME="u-boot-sunxi-with-spl.bin"
BR2_PACKAGE_HOST_UBOOT_TOOLS=y
BR2_PACKAGE_HOST_UBOOT_TOOLS_BOOT_SCRIPT=y
BR2_PACKAGE_HOST_UBOOT_TOOLS_BOOT_SCRIPT_SOURCE="board/friendlyarm/nanopi-neo/boot.cmd"

# Build an sdcard image
BR2_TARGET_ROOTFS_EXT2=y
BR2_TARGET_ROOTFS_EXT2_4=y
BR2_ROOTFS_POST_IMAGE_SCRIPT="support/scripts/genimage.sh"
BR2_ROOTFS_POST_SCRIPT_ARGS="-c board/friendlyarm/nanopi-neo/genimage.cfg"
# BR2_TARGET_ROOTFS_TAR is not set

# Additional tools
BR2_PACKAGE_HOST_DOSFSTOOLS=y
BR2_PACKAGE_HOST_GENIMAGE=y
BR2_PACKAGE_HOST_MTOOLS=y

#############################################
# audioinjector_custom_defconfig from here on
#
BR2_TARGET_GENERIC_HOSTNAME="audioinjector"
BR2_TARGET_GENERIC_ISSUE="Welcome to Audio Injector OS"

# neo specific from here on ...
#BR2_TARGET_ROOTFS_EXT2_SIZE="250M"
BR2_DL_DIR="$(BASE_DIR)/../../buildroot.dl"

#BR2_TOOLCHAIN_BUILDROOT_WCHAR=y

BR2_GLOBAL_PATCH_DIR="$(BR2_EXTERNAL)/patches"

# package options
#BR2_PACKAGE_FFTW_USE_NEON=y
#BR2_PACKAGE_EIGEN_UNSUPPORTED_MODULES=y

# buildroot packages

# wifi
#BR2_PACKAGE_WPA_SUPPLICANT=y
#BR2_PACKAGE_RPI_WIFI_FIRMWARE=y
#BR2_PACKAGE_RPI_FIRMWARE_INSTALL_DTB_OVERLAYS=y

BR2_PACKAGE_BUSYBOX_CONFIG_FRAGMENT_FILES="$(BR2_EXTERNAL)/configs/busybox.fragment"

# setup options
BR2_ROOTFS_OVERLAY="$(BR2_EXTERNAL)/overlays"
#BR2_ROOTFS_USERS_TABLES="$(BR2_EXTERNAL)/users.txt"

# external packages
BR2_PACKAGE_NTP=y
BR2_PACKAGE_NTP_NTPDATE=y

BR2_PACKAGE_OPENSSH=y
#BR2_SYSTEM_DHCP="eth0"

BR2_PACKAGE_AVAHI=y
BR2_PACKAGE_AVAHI_DAEMON=y

# audio stuff
BR2_PACKAGE_ALSA_LIB=y
BR2_PACKAGE_LIBSAMPLERATE=y
BR2_PACKAGE_ALSA_UTILS=y
BR2_PACKAGE_ALSA_UTILS_AMIXER=y
BR2_PACKAGE_ALSA_UTILS_APLAY=y

# audio drivers
BR2_PACKAGE_AUDIOINJECTOR_ALSA=y
# device tree setup
BR2_LINUX_KERNEL_DTS_SUPPORT=y
BR2_LINUX_KERNEL_USE_CUSTOM_DTS=y
BR2_LINUX_KERNEL_CUSTOM_DTS_PATH="$(BR2_EXTERNAL)/package/audioinjector-alsa/audioinjector-nanopi/audioinjector-nanopi-neo-stereo.dts"
BR2_LINUX_KERNEL_CONFIG_FRAGMENT_FILES="$(BR2_EXTERNAL)/package/audioinjector-alsa/audioinjector-nanopi/kernel.fragment"

#
BR2_TARGET_GENERIC_HOSTNAME="audioinjector"
BR2_TARGET_GENERIC_ISSUE="Welcome to Audio Injector OS"

# neo specific from here on ...
#BR2_TARGET_ROOTFS_EXT2_SIZE="250M"
BR2_DL_DIR="$(BASE_DIR)/../../buildroot.dl"

#BR2_TOOLCHAIN_BUILDROOT_WCHAR=y

BR2_GLOBAL_PATCH_DIR="$(BR2_EXTERNAL)/patches"

# package options
#BR2_PACKAGE_FFTW_USE_NEON=y
#BR2_PACKAGE_EIGEN_UNSUPPORTED_MODULES=y

# buildroot packages

# wifi
#BR2_PACKAGE_WPA_SUPPLICANT=y
#BR2_PACKAGE_RPI_WIFI_FIRMWARE=y
#BR2_PACKAGE_RPI_FIRMWARE_INSTALL_DTB_OVERLAYS=y

BR2_PACKAGE_BUSYBOX_CONFIG_FRAGMENT_FILES="$(BR2_EXTERNAL)/configs/busybox.fragment"

# setup options
BR2_ROOTFS_OVERLAY="$(BR2_EXTERNAL)/overlays"
#BR2_ROOTFS_USERS_TABLES="$(BR2_EXTERNAL)/users.txt"

# external packages
BR2_PACKAGE_NTP=y
BR2_PACKAGE_NTP_NTPDATE=y

BR2_PACKAGE_OPENSSH=y
#BR2_SYSTEM_DHCP="eth0"

BR2_PACKAGE_AVAHI=y
BR2_PACKAGE_AVAHI_DAEMON=y

# audio stuff
BR2_PACKAGE_ALSA_LIB=y
BR2_PACKAGE_LIBSAMPLERATE=y
BR2_PACKAGE_ALSA_UTILS=y
BR2_PACKAGE_ALSA_UTILS_AMIXER=y
BR2_PACKAGE_ALSA_UTILS_APLAY=y

# audio drivers
BR2_PACKAGE_AUDIOINJECTOR_ALSA=y
# device tree setup
BR2_LINUX_KERNEL_DTS_SUPPORT=y
BR2_LINUX_KERNEL_USE_CUSTOM_DTS=y
BR2_LINUX_KERNEL_CUSTOM_DTS_PATH="$(BR2_EXTERNAL)/package/audioinjector-alsa/audioinjector-nanopi/audioinjector-nanopi-neo-stereo.dts"
BR2_LINUX_KERNEL_CONFIG_FRAGMENT_FILES="$(BR2_EXTERNAL)/package/audioinjector-alsa/audioinjector-nanopi/kernel.fragment"
```

## package/Config.in
```kconfig
menu "Packages"
source "$BR2_EXTERNAL_NEO_PATH/package/gtkiostream/Config.in"
source "$BR2_EXTERNAL_NEO_PATH/package/audioinjector-alsa/Config.in"
endmenu
```

## package/audioinjector-alsa/Config.in
```kconfig
config BR2_PACKAGE_AUDIOINJECTOR_ALSA
	bool "audioinjector-alsa"
	depends on BR2_LINUX_KERNEL
	help
	  Audio Injector ALSA machine driver

	  http://www.audioinjector.net
```

## package/audioinjector-alsa/audioinjector-nanopi/Kconfig
```kconfig
config SND_SOC_AUDIOINJECTOR_NANOPI_NEO_STEREO
        tristate "Audio Injector NanoPi Neo platform machine driver"
        select SND_SOC_WM8731
        default n
        help
          Audio Injector ALSA machine driver for the NanoPi Neo platform.
```
